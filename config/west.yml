## config/west.yml
```yaml
manifest:
  remotes:
    - name: zmkfirmware
      url-base: https://github.com/zmkfirmware
    - name: BiggRigg
      url-base: https://github.com/BiggRigg
  projects:
    - name: zmk
      remote: BiggRigg
      revision: rotrlayer
      import: app/west.yml
  self:
    path: config
```
